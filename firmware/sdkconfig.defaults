## firmware/sdkconfig.defaults
```kconfig
# ESP32-S3 Configuration
CONFIG_IDF_TARGET_ESP32S3=y
CONFIG_ESP32S3_SPIRAM_SUPPORT=y
CONFIG_SPIRAM_USE_CAPS_ALLOC=y
CONFIG_SPIRAM_MALLOC_ALWAYSINTERNAL=16384

# Partition Table
CONFIG_PARTITION_TABLE_CUSTOM=y
CONFIG_PARTITION_TABLE_CUSTOM_FILENAME="partitions.csv"

# WiFi
CONFIG_ESP_WIFI_ENABLED=y
CONFIG_ESP_WIFI_STA_ENABLED=y
CONFIG_ESP_WIFI_SOFTAP_ENABLED=y

# OTA
CONFIG_ESP_HTTPS_OTA=y
CONFIG_ESP_HTTPS_OTA_ALLOW_HTTP=y

# MQTT
CONFIG_MQTT_PROTOCOL_311=y

# TLS/Certificates
CONFIG_MBEDTLS_CERTIFICATE_BUNDLE=y
CONFIG_MBEDTLS_CERTIFICATE_BUNDLE_DEFAULT_FULL=y

# SPIFFS for thin mode web pages
CONFIG_SPIFFS=y

# Bootloader
CONFIG_BOOTLOADER_APP_ROLLBACK_ENABLE=y

# FreeRTOS
CONFIG_FREERTOS_HZ=1000
CONFIG_ESPTOOLPY_FLASHSIZE_16MB=y
CONFIG_ESPTOOLPY_FLASHSIZE="16MB"
```
